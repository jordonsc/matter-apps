## omni/main/Kconfig.projbuild
```kconfig
menu "Omni"
	menu "Reset"
		config APP_RESET_ENABLED
			bool "Factory reset feature enabled"
			default y
			help
				Allows a GPIO pin to trigger a factory reset
		
		config RESET_GPIO_PIN
			depends on APP_RESET_ENABLED
			int "Reset button GPIO pin"
			default 0
			range 0 50
			help
				Pin number for GPIO reset button.

		config RESET_HOLD_TIME
			depends on APP_RESET_ENABLED
			int "Reset button hold time"
			default 3000
			range 1 10000
			help
				Time in ms the reset button must be held
		
	endmenu

	menu "Switch"
		config APP_BUTTON_ENABLED
			bool "Switch feature enabled"
			default n
			help
				Enables the Generic Switch feature to create momentary button or latching switch endpoints.
		
		config BUTTON_GPIO_LIST
			depends on APP_BUTTON_ENABLED
			string "Switch GPIO list"
			default "M9"
			help
				A space-separated list of switch specifications.
				L9    - latching on pin 9
				M9    - momentary on pin 9
				MD9   - momentary-double-click on pin 9
				ML9   - momentary-long-press on pin 9
				MX9   - momentary-double-click-long-press on pin 9
				M9:12 - momentary on pin 9 with output on pin 12

		
		config BUTTON_LONG_PRESS_TIME_MS
			depends on APP_BUTTON_ENABLED
			int "Time in ms for a long-press to register"
			default 750
			range 1 10000
			help
				How long must a button remain pressed before it is deemed a long press.

	endmenu

	menu "OnOff"
		config APP_ONOFF_ENABLED
			bool "OnOff feature enabled"
			default n
			help
				Enables on/off devices (lights, outlets, switches) that can be toggled via GPIO buttons.
		
		config ONOFF_GPIO_LIST
			depends on APP_ONOFF_ENABLED
			string "OnOff GPIO list"
			default "L34"
			help
				A space-separated list of on/off device specifications.
				L34    - Light on pin 34
				O22    - Outlet on pin 22
				L34:12 - Light on pin 34 with output on pin 12

		
	endmenu

	menu "Sensor"
		config APP_SENSOR_ENABLED
			bool "Sensor feature enabled"
			default n
			help
				Enables binary sensors that are triggered by GPIO pin state changes.
				Supports occupancy sensors (OccupancySensing cluster) and generic sensors (BooleanState cluster).
		
		config SENSOR_GPIO_LIST
			depends on APP_SENSOR_ENABLED
			string "Sensor GPIO list"
			default "O34"
			help
				A space-separated list of sensor specifications.
				O34     - Occupancy sensor on pin 34
				OI34    - Occupancy sensor on pin 34 with logic inverted
				G12     - Generic sensor (BooleanState cluster) on pin 12
				GI12    - Generic sensor on pin 12 with logic inverted
				OI34:9  - Occupancy sensor on pin 34 with logic inverted and output on pin 9

		
	endmenu

	menu "HX711 Load Cell"
		config APP_HX711_ENABLED
			bool "HX711 Load Cell feature enabled"
			default n
			help
				Enables HX711 load cell sensors that provide weight measurements via Matter.
				Creates generic sensor endpoints with weight values.

		config HX711_GPIO_LIST
			depends on APP_HX711_ENABLED
			string "HX711 GPIO list"
			default "2:4"
			help
				A space-separated list of HX711 sensor specifications.
				Format: "SCK:DOUT" or "SCK:DOUT:SCALE"
				Examples:
				2:4        - HX711 with SCK on pin 2, DOUT on pin 4
				5:18:2048.0 - HX711 with SCK on pin 5, DOUT on pin 18, scale factor 2048.0


		config HX711_READING_INTERVAL_MS
			depends on APP_HX711_ENABLED
			int "Reading interval in milliseconds"
			default 1000
			range 100 60000
			help
				How often to read the HX711 sensors and update Matter attributes.

	endmenu

	menu "A01NYUB Ultrasonic Sensor"
		config APP_A01NYUB_ENABLED
			bool "A01NYUB Ultrasonic Sensor feature enabled"
			default n
			help
				Enables DFRobot A01NYUB waterproof ultrasonic distance sensors.
				Sensors communicate via UART and measure distances from 28cm to 750cm.

		config A01NYUB_UART_LIST
			depends on APP_A01NYUB_ENABLED
			string "A01NYUB UART configuration list"
			default "1:5:15"
			help
				A space-separated list of A01NYUB sensor UART configurations.
				Format: "UART:TX:RX"
				Examples:
				1:16:17 - A01NYUB on UART1, TX pin 5, RX pin 15

		config A01NYUB_BAUD_RATE
			depends on APP_A01NYUB_ENABLED
			int "UART baud rate"
			default 9600
			help
				Baud rate for A01NYUB sensor communication.
				Default is 9600 (standard for A01NYUB).

		config A01NYUB_MODE
			depends on APP_A01NYUB_ENABLED
			int "Sensor mode"
			default 1
			range 0 1
			help
				Output mode for A01NYUB sensor:
				0 = Processed mode (steadier readings, 250ms polling)
				1 = Real-time mode (faster updates, 150ms polling)

				Reading interval is automatically set based on sensor mode.

	endmenu

	menu "SDN Blinds"
		config APP_SDN_ENABLED
			bool "SDN Blinds feature enabled"
			default n
			help
				Enables Somfy SDN (RS485) blind control via Matter WindowCovering.
				Controls Somfy Sonesse motors over the SDN bus using a TTL-to-RS485
				adapter with auto direction control (no RTS/DE pin needed).
				The first motor discovered on the bus is used automatically.

		config SDN_UART_NUM
			depends on APP_SDN_ENABLED
			int "UART port number"
			default 1
			range 0 2
			help
				UART port number for the RS485 transceiver.

		config SDN_TX_PIN
			depends on APP_SDN_ENABLED
			int "UART TX GPIO pin"
			default 16
			range 0 50
			help
				GPIO pin connected to the RS485 transceiver TXD.

		config SDN_RX_PIN
			depends on APP_SDN_ENABLED
			int "UART RX GPIO pin"
			default 17
			range 0 50
			help
				GPIO pin connected to the RS485 transceiver RXD.

		config SDN_POLL_INTERVAL_MS
			depends on APP_SDN_ENABLED
			int "Position poll interval (ms)"
			default 2000
			range 500 30000
			help
				How often to query the motor for its current position when idle.
				During movement, polling runs at 500ms regardless of this setting.

	endmenu

endmenu
```

## omni/sdkconfig.defaults.esp32c6
```kconfig
CONFIG_IDF_TARGET="esp32c6"

# TinyC6 settings
CONFIG_ESPTOOLPY_FLASHSIZE_4MB=n
CONFIG_ESPTOOLPY_FLASHSIZE_8MB=y
CONFIG_ESP_CONSOLE_USB_SERIAL_JTAG=y
```

## omni/sdkconfig.defaults.esp32s3
```kconfig
CONFIG_IDF_TARGET="esp32s3"

# TinyS3 settings
CONFIG_ESPTOOLPY_FLASHSIZE_4MB=n
CONFIG_ESPTOOLPY_FLASHSIZE_8MB=y
CONFIG_ESP_CONSOLE_USB_SERIAL_JTAG=y
```

## switch/main/Kconfig.projbuild
```kconfig
 menu "Application"

	menu "Switch"
		config GENERIC_SWITCH_TYPE
			choice
				prompt "Switch type"
				default GENERIC_SWITCH_TYPE_MOMENTARY
				help
					Select between a latching switch or momentary button.

				config GENERIC_SWITCH_TYPE_LATCHING
					bool "[LS] Latching switch"

				config GENERIC_SWITCH_TYPE_MOMENTARY
					bool "[AS] Momentary action-switch with optional double-click and long-press"			
			endchoice
		
		config BUTTON_GPIO_LIST
			string "Comma delimited list of GPIO numbers to add switches"
			default "9"

		config BUTTON_COUNT
			int "Numer of items in GPIO list"
			default 1
			range 1 50

		config BUTTON_ENABLE_DOUBLE_CLICK
			bool "Enable double-clicking of momentary buttons"

		config BUTTON_ENABLE_LONG_PRESS
			bool "Enable long-pressing of momentary buttons"

		config BUTTON_LONG_PRESS_TIME
			int "Time in ms for a button-hold to be considered a long-press"
			default 750
			range 1 10000
	endmenu



endmenu
```
